## boards/shields/cadpad/Kconfig.defconfig
```kconfig
if SHIELD_CADPAD
  config ZMK_KEYBOARD_NAME
    default "cadpad"

config ZMK_PM_SOFT_OFF
    default y

CONFIG_ZMK_DISPLAY=y
CONFIG_ZMK_WIDGET_BATTERY_STATUS=y
CONFIG_ZMK_EXT_POWER=y

endif
```
